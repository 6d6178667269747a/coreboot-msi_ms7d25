## src/mainboard/lenovo/m900_tiny/Kconfig
```kconfig
if BOARD_LENOVO_THINKCENTRE_M900_TINY

config BOARD_SPECIFIC_OPTIONS
	def_bool y
	select BOARD_ROMSIZE_KB_16384
	select HAVE_ACPI_RESUME
	select HAVE_ACPI_TABLES
	select MAINBOARD_HAS_LIBGFXINIT
	select HAVE_OPTION_TABLE
	select HAVE_CMOS_DEFAULT
	select INTEL_GMA_HAVE_VBT
	select INTEL_INT15
	select SOC_INTEL_KABYLAKE
	select SKYLAKE_SOC_PCH_H
	select MAINBOARD_HAS_TPM1
	#select MAINBOARD_HAS_TPM2
	select SUPERIO_NUVOTON_NCT6687D
	select SUPERIO_NUVOTON_COMMON_COM_A
	select DRIVERS_UART_8250IO
	select MAINBOARD_USES_IFD_GBE_REGION
	#select CRB_TPM
	select MEMORY_MAPPED_TPM
	#select HAVE_INTEL_PTT

config DISABLE_HECI1_AT_PRE_BOOT
	default y

config MAINBOARD_DIR
	default "lenovo/m900_tiny"

config MAINBOARD_PART_NUMBER
	default "ThinkCentre M900 Tiny"

config PRERAM_CBMEM_CONSOLE_SIZE
	hex
	default 0xd00

config DIMM_SPD_SIZE
	default 512 #DDR4

config DRIVER_LENOVO_SERIALS
	bool
	default n

endif
```
